/* STM32U545RE(U5) on NUCLEO-U545RE-Q
 * - 512 KB internal Flash @ 0x0800_0000
 * - 256 KB SRAM (SRAM1+SRAM2)  @ 0x2000_0000
 */

MEMORY
{
  rom  (rx)  : ORIGIN = 0x08000000, LENGTH = 0x00040000  /* 512 KB */
  prog (rx)  : ORIGIN = 0x08040000, LENGTH = 0x00040000  /* same 512 KB */
  ram  (rwx) : ORIGIN = 0x20000000, LENGTH = 0x00040000  /* 256 KB */
}

PAGE_SIZE = 8K; 
MPU_MIN_ALIGN = 8K;
